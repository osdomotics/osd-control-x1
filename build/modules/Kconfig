## build/modules/Kconfig
```kconfig
menu "Kernel external modules"
source modules/charlcd/Kconfig
source build/modules/gpio/Kconfig
source modules/minimal/Kconfig
source modules/redpine/Kconfig
source modules/uart_appkit/Kconfig
endmenu
```

## build/modules/gpio/Kconfig
```kconfig
config DEL_KMOD_GPIO
	bool gpio
	default y
	help
	  Example GPIO kernel module

	  Provides access to gpio's from user space applications

config DEL_KMOD_GPIO_DIR
	string
	depends on DEL_KMOD_GPIO
	default gpio
```

## configs/Kconfig
```kconfig
config DEL_CME9210JS
	def_bool y

menu "Linux Kernel Configuration"
source kernel/Kconfig
source kernel/linux-2.6.35/arch/arm/Kconfig
endmenu

config DEL_ENDCONFIG_LINUX
	def_bool y

menu "External Modules Configuration"
source build/modules/Kconfig
endmenu

menu "Rootfs Configuration"
source rootfs/Kconfig
endmenu
```
